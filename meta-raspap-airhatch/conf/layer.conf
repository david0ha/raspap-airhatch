## meta-raspap-airhatch/conf/layer.conf
```bitbake
BBPATH .= ":${LAYERDIR}"
BBFILES += "${LAYERDIR}/recipes-*/*/*.bb \
            ${LAYERDIR}/recipes-*/*/*.bbappend"

BBFILE_COLLECTIONS += "raspap-airhatch"
BBFILE_PATTERN_raspap-airhatch = "^${LAYERDIR}/"
BBFILE_PRIORITY_raspap-airhatch = "7"

LAYERVERSION_raspap-airhatch = "1"
LAYERDEPENDS_raspap-airhatch = "core raspap networking-layer"
LAYERSERIES_COMPAT_raspap-airhatch = "wrynose"
```
